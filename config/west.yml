## config/west.yml
```yaml
manifest:
  remotes:
    - name: zmkfirmware
      url-base: https://github.com/zmkfirmware
	- name: infused-kim
	  url-base: https://github.com/infused-kim/my-changes/
  projects:
    - name: zmk
      remote: infused-kim
      revision: split-encoder
      import: app/west.yml
  self:
    path: config
```
